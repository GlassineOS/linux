## Documentation/devicetree/bindings/display/panel/onyx,noteair-eink-link.yaml
```yaml
# SPDX-License-Identifier: (GPL-2.0-only OR BSD-2-Clause)
%YAML 1.2
---
$id: http://devicetree.org/schemas/display/panel/onyx,noteair-eink-link.yaml#
$schema: http://devicetree.org/meta-schemas/core.yaml#

title: Onyx Boox Note Air e-ink link

maintainers:
  - Moritz Meißelbach <moritz@glassine.org>

description: |
  The Note Air drives its e-ink panel as a software timing controller: the
  CPU computes every drive frame and sends it over DSI, in command mode, to
  a TC358762 bridge whose parallel outputs carry the panel's source data and
  control signals. This node is that link, a DSI peripheral of the host.

  The driver also powers and sets up the bridge, and switches the panel's
  high-voltage rails in the MAX17135 power IC. It reaches both chips over
  I2C, through the nodes that onyx,bridge and onyx,pmic point to.

allOf:
  - $ref: panel-common.yaml#

properties:
  compatible:
    const: onyx,noteair-eink-link

  reg:
    maxItems: 1

  onyx,bridge:
    $ref: /schemas/types.yaml#/definitions/phandle
    description: The I2C device node of the TC358762 bridge's register port.

  onyx,pmic:
    $ref: /schemas/types.yaml#/definitions/phandle
    description: The I2C device node of the MAX17135 panel power IC.

  osc-gpios:
    maxItems: 1
    description: Enables the bridge's reference oscillator.

  mode0-gpios:
    maxItems: 1
    description: The bridge's MD0 pin, high while frames stream.

  reset-gpios:
    maxItems: 1
    description: The bridge's reset line.

  vddc-gpios:
    maxItems: 1
    description: Enables the bridge's core supply.

  pmic-pwrgood-gpios:
    maxItems: 1
    description: The power IC's power-good output.

  vdd1v8-supply:
    description: The bridge's 1.8 V supply.

  vddio-supply:
    description: The bridge's I/O supply.

  v3p3-supply:
    description: The power IC's input supply.

  s5a-supply:
    description:
      Parent of the DSI host's regulators. The driver may hold a load on it
      while the link is up.

  s2b-supply:
    description:
      Parent of the DSI host's regulators. The driver may hold a load on it
      while the link is up.

  wcn-l5-supply:
    description: A rail shared with the wireless chip, optionally held while the link is up.

  wcn-l6-supply:
    description: A rail shared with the wireless chip, optionally held while the link is up.

  wcn-l9-supply:
    description: A rail shared with the wireless chip, optionally held while the link is up.

  wcn-l19-supply:
    description: A rail shared with the wireless chip, optionally held while the link is up.

  clocks:
    minItems: 2
    items:
      - description: The DSI host's pixel clock
      - description: The DSI host's byte clock
      - description: An RF reference clock, optionally held while the link is up

  clock-names:
    minItems: 2
    items:
      - const: pclk
      - const: byte
      - const: rfclk

  power-domains:
    maxItems: 1
    description: A power domain optionally held while the link is up.

  power-domain-names:
    items:
      - const: mx

  port: true

required:
  - compatible
  - reg
  - onyx,bridge
  - onyx,pmic
  - osc-gpios
  - mode0-gpios
  - reset-gpios
  - vddc-gpios
  - pmic-pwrgood-gpios
  - vdd1v8-supply
  - vddio-supply
  - v3p3-supply
  - port

unevaluatedProperties: false

examples:
  - |
    #include <dt-bindings/gpio/gpio.h>

    dsi {
        #address-cells = <1>;
        #size-cells = <0>;

        panel@0 {
            compatible = "onyx,noteair-eink-link";
            reg = <0>;

            onyx,bridge = <&epd_bridge>;
            onyx,pmic = <&epd_pmic>;
            osc-gpios = <&tlmm 55 GPIO_ACTIVE_HIGH>;
            mode0-gpios = <&tlmm 43 GPIO_ACTIVE_HIGH>;
            reset-gpios = <&tlmm 42 GPIO_ACTIVE_LOW>;
            vddc-gpios = <&tlmm 45 GPIO_ACTIVE_HIGH>;
            pmic-pwrgood-gpios = <&tlmm 52 GPIO_ACTIVE_HIGH>;
            vdd1v8-supply = <&vreg_1p8>;
            vddio-supply = <&epd_vddio>;
            v3p3-supply = <&vreg_3p0>;

            port {
                endpoint {
                    remote-endpoint = <&dsi0_out>;
                };
            };
        };
    };
```

## Documentation/devicetree/bindings/sound/awinic,aw88194.yaml
```yaml
# SPDX-License-Identifier: (GPL-2.0-only OR BSD-2-Clause)
%YAML 1.2
---
$id: http://devicetree.org/schemas/sound/awinic,aw88194.yaml#
$schema: http://devicetree.org/meta-schemas/core.yaml#

title: Awinic AW88194 smart audio amplifier

maintainers:
  - Moritz Meißelbach <moritz@glassine.org>

description:
  The AW88194 is a mono class-D speaker amplifier with a DSP, on I2C for
  control and I2S for audio. The driver loads its register profile, DSP
  firmware and DSP configuration from files before the first unmute.

allOf:
  - $ref: dai-common.yaml#

properties:
  compatible:
    const: awinic,aw88194

  reg:
    maxItems: 1

  "#sound-dai-cells":
    const: 0

  reset-gpios:
    maxItems: 1

  firmware-name:
    maxItems: 1
    description:
      Path prefix of the files the driver loads, without the suffix. It
      appends "_reg.bin", "_fw.bin" and "_cfg.bin".

required:
  - compatible
  - reg
  - "#sound-dai-cells"

unevaluatedProperties: false

examples:
  - |
    #include <dt-bindings/gpio/gpio.h>

    i2c {
        #address-cells = <1>;
        #size-cells = <0>;

        audio-codec@35 {
            compatible = "awinic,aw88194";
            reg = <0x35>;
            reset-gpios = <&gpio 94 GPIO_ACTIVE_LOW>;
            firmware-name = "aw88194_spk";
            #sound-dai-cells = <0>;
        };
    };
```
